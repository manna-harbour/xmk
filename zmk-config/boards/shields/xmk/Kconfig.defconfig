## zmk-config/boards/shields/xmk/Kconfig.defconfig
```kconfig
# Copyright 2022 Manna Harbour
# https://github.com/manna-harbour/xmk

if SHIELD_XMK

config ZMK_KEYBOARD_NAME
	default "XMK"

endif
```

## zmk-config/boards/shields/xmk/Kconfig.shield
```kconfig
# Copyright 2022 Manna Harbour
# https://github.com/manna-harbour/xmk

config SHIELD_XMK
	def_bool $(shields_list_contains,xmk)
```

## zmk-config/west.yml
```yaml
# Copyright 2022 Manna Harbour
# https://github.com/manna-harbour/xmk

manifest:
  remotes:
    - name: zmkfirmware
      url-base: https://github.com/zmkfirmware
    - name: petejohanson
      url-base: https://github.com/petejohanson
  projects:
    - name: zmk
#      remote: zmkfirmware
#      revision: main
      remote: petejohanson
      revision: shell/tap-command
      import: app/west.yml
  self:
    path: config
```
